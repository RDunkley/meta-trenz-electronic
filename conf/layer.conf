## conf/layer.conf
```bitbake
###################################################################################################
# Identifies the meta-trenz-electronic layer and defines it's requirements.
# Copyright Richard Dunkley 2020
###################################################################################################

# We have a conf and classes directory, add to BBPATH
BBPATH .= ":${LAYERDIR}"

# We have recipes-* directories, add to BBFILES
BBFILES += "${LAYERDIR}/recipes-*/*/*.bb \
	${LAYERDIR}/recipes-*/*/*.bbappend"

BBFILE_COLLECTIONS += "trenz-electronic"
BBFILE_PATTERN_trenz-electronic = "^${LAYERDIR}/"
BBFILE_PRIORITY_trenz-electronic = "5"
LAYERDEPENDS_trenz-electronic = "core openembedded-layer xilinx-tools xilinx"
LAYERSERIES_COMPAT_trenz-electronic = "sumo thud"
```

## conf/machine/te0807-02-07ev.conf
```bitbake
#@TYPE: Machine
#@NAME: te0807-02-07ev
#@DESCRIPTION: Trenz Electronic TE0807-02-07EV Board

SOC_VARIANT ?= "ev"

require conf/machine/include/tune-zynqmp.inc
require conf/machine/include/machine-xilinx-overrides.inc
require conf/machine/include/machine-xilinx-default.inc

# Added for answer record #72377
IMAGE_INSTALL_append = " haveged"

SYSTEM_USER_DTSI = "te0807-02-07ev.dtsi"

MACHINE_FEATURES = "rtc ext2 ext3 vfat usbhost"

UBOOT_MACHINE = "te0807-02-07ev_defconfig"
SPL_BINARY ?= "spl/boot.bin"

SERIAL_CONSOLE = "115200 ttyPS0"
SERIAL_CONSOLES_CHECK = "${SERIAL_CONSOLES}"

#KERNEL_DEVICETREE_append = "xilinx/te0807-02-07ev.dtb"

PREFERRED_PROVIDER_virtual/kernel ?= "linux-xlnx"
PREFERRED_PROVIDER_virtual/bootloader ?= "u-boot-xlnx"
PREFERRED_PROVIDER_virtual/boot-bin ?= "xilinx-bootbin"

#PMU_FIRMWARE_IMAGE_NAME ?= "pmu-firmware-zynqmp-pmu"
#PMU_FIRMWARE_DEPLOY_DIR ?= "${TOPDIR}/pmutmp/deploy/images/zynqmp-pmu"

EXTRA_IMAGEDEPENDS += " \
	u-boot-zynq-uenv \
	arm-trusted-firmware \
	virtual/boot-bin \
	virtual/bootloader \
	"

IMAGE_BOOT_FILES += " \
		uEnv.txt \
		atf-uboot.ub \
		boot.bin \
		system.dtb \
		"
```

## conf/machine/te0820-03-03eg.conf
```bitbake
#@TYPE: Machine
#@NAME: te0820-03-03eg
#@DESCRIPTION: Trenz Electronic TE0820-03-03EG Board

SOC_VARIANT ?= "eg"

require conf/machine/include/soc-zynqmp.inc
require conf/machine/include/machine-xilinx-default.inc

# Added for answer record #72377
IMAGE_INSTALL:append = " haveged"

SYSTEM_USER_DTSI = "te0820-03-03eg.dtsi"

MACHINE_FEATURES = "rtc ext2 ext3 vfat usbhost"

UBOOT_MACHINE = "te0820-03-03eg_defconfig"
DEVICE_TREE = "system-top"
SPL_BINARY ?= "spl/boot.bin"

SERIAL_CONSOLE = "115200;ttyPS0"
SERIAL_CONSOLES_CHECK = "${SERIAL_CONSOLES}"

#KERNEL_DEVICETREE:append = "xilinx/te0820-03-03eg.dtb"

PREFERRED_PROVIDER_virtual/kernel ?= "linux-xlnx"
PREFERRED_PROVIDER_virtual/bootloader ?= "u-boot-xlnx"
PREFERRED_PROVIDER_virtual/boot-bin ?= "xilinx-bootbin"
PREFERRED_PROVIDER_qemu-native = "qemu-xilinx-native"

#PMU_FIRMWARE_IMAGE_NAME ?= "pmu-firmware-zynqmp-pmu"
#PMU_FIRMWARE_DEPLOY_DIR ?= "${TOPDIR}/pmutmp/deploy/images/zynqmp-pmu"

EXTRA_IMAGEDEPENDS += " \
	u-boot-zynq-uenv \
	arm-trusted-firmware \
	virtual/boot-bin \
	virtual/bootloader \
	u-boot-zynq-scr \
	fsbl \
	"

IMAGE_BOOT_FILES += " \
		atf-uboot.ub \
		boot.bin \
		system.dtb \
		boot.scr \
		"
```
